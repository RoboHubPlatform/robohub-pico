## Kconfig
```kconfig
# robohub-pico Kconfig
# Platform-level configuration for Pico boards.

menu "RoboHub Pico Platform"

config RH_HAL_GPIO
    bool "GPIO HAL"
    default y
    help
      Enable GPIO peripheral HAL implementation.

config RH_HAL_I2C
    bool "I2C HAL"
    default y
    help
      Enable I2C peripheral HAL implementation.

config RH_HAL_SPI
    bool "SPI HAL"
    default y
    help
      Enable SPI peripheral HAL implementation.

config RH_HAL_UART
    bool "UART HAL"
    default y
    help
      Enable UART peripheral HAL implementation.

config RH_HAL_TIMER
    bool "Timer HAL"
    default y
    help
      Enable Timer HAL implementation.

config RH_HAL_RS485
    bool "RS485 HAL"
    default n
    help
      Enable RS485 HAL implementation.

config RH_HAL_ONEWIRE
    bool "1-Wire HAL"
    default n
    help
      Enable the software 1-Wire HAL implementation. A DS18B20 temperature
      module and anything else on a 1-Wire bus selects it.

config RH_CONSOLE_USB
    bool "Console over USB"
    default n
    help
      Send the console over the board's own USB port as a CDC serial device,
      instead of the UART pins. A host then sees a serial port on the same
      cable that flashes the board, so output needs no adapter.
      A board whose USB is used for something else leaves this off.

config RH_UPDATE_IMAGE
    bool "Build an update image"
    default n
    help
      Build the program as an update sent over the link: flagged
      try-before-you-buy, so the boot ROM gives it a trial after a flash update
      boot and it is kept only once it confirms (robohub ADR-0023). An image
      flashed over USB is built without it.

endmenu
```

## examples/c/update_check/Kconfig
```kconfig
# update_check configuration

config RH_HAL_GPIO
    bool "GPIO"
    default y

config RH_HAL_UART
    bool "UART"
    default y

config RH_HAL_TIMER
    bool "Timer"
    default y

config RH_BOARD_PICO_2W
    bool "Pico 2W"
    default y

config UPDATE_CHECK_VERSION
    int "The firmware version this image reports"
    default 1

config UPDATE_CHECK_HANG
    bool "Hang when running on trial"
    default n
```
