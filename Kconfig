## Kconfig
```kconfig
# robohub-pico Kconfig
# Platform-level configuration for Pico boards.

menu "RoboHub Pico Platform"

config RH_HAL_GPIO
    bool "GPIO HAL"
    default y
    help
      Enable GPIO peripheral HAL implementation.

config RH_HAL_I2C
    bool "I2C HAL"
    default y
    help
      Enable I2C peripheral HAL implementation.

config RH_HAL_SPI
    bool "SPI HAL"
    default y
    help
      Enable SPI peripheral HAL implementation.

config RH_HAL_UART
    bool "UART HAL"
    default y
    help
      Enable UART peripheral HAL implementation.

config RH_HAL_TIMER
    bool "Timer HAL"
    default y
    help
      Enable Timer HAL implementation.

config RH_HAL_RS485
    bool "RS485 HAL"
    default n
    help
      Enable RS485 HAL implementation.

config RH_CONSOLE_USB
    bool "Console over USB"
    default n
    help
      Send the console over the board's own USB port as a CDC serial device,
      instead of the UART pins. A host then sees a serial port on the same
      cable that flashes the board, so output needs no adapter.
      A board whose USB is used for something else leaves this off.

endmenu
```

## boards/pico2w/Kconfig
```kconfig
# pico2w board Kconfig

config RH_BOARD_PICO_2W
    bool "Raspberry Pi Pico 2W"
    select RH_HAL_GPIO
    select RH_HAL_UART
    select RH_HAL_TIMER
    select RH_HAL_I2C
    select RH_HAL_SPI
    default y
    help
      Raspberry Pi Pico 2W with RP2350 (Cortex-M33).
```

## examples/c/hello_world/Kconfig
```kconfig
# hello_world configuration

config RH_HAL_GPIO
    bool "GPIO"
    default y

config RH_HAL_UART
    bool "UART"
    default y

config RH_HAL_TIMER
    bool "Timer"
    default y

config RH_BOARD_PICO_2W
    bool "Pico 2W"
    default y
```
